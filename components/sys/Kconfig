## components/sys/Kconfig
```kconfig
menu "Sys"

    config SYS_LED_GPIO
        int "Status LED GPIO"
        default -1
        help
            GPIO number of a simple on-board LED used for status indication.
            Set to -1 if the board has no status LED (headless operation).

endmenu
```

## components/tuya_cloud/Kconfig
```kconfig
menu "Tuya Cloud"

    config TUYA_NTP_SERVER
        string "NTP server used for time sync"
        default "pool.ntp.org"
        help
            SNTP server for TimeSync::SyncBlocking() (X-time and token
            expiry are ms since epoch). A regional pool lowers
            first-sync latency.

endmenu
```

## main/Kconfig.projbuild
```kconfig
menu "Tuya Hub"

    choice HUB_LANG
        prompt "Default UI language"
        default HUB_LANG_EN
        help
            Default language for the Web Control UI (can be changed at runtime
            from the Settings page).

        config HUB_LANG_VI
            bool "Vietnamese"
        config HUB_LANG_EN
            bool "English"
    endchoice

endmenu
```
